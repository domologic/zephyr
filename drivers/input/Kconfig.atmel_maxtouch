## drivers/input/Kconfig.atmel_maxtouch
```kconfig
# Copyright (c) 2024 Domologic Home Automation GmbH
# SPDX-License-Identifier: Apache-2.0

config INPUT_ATMEL_MAXTOUCH
    bool "Atmel maXTouch trackpads"
    default y
    depends on GPIO
    depends on I2C
    depends on INPUT
    depends on DT_HAS_ATMEL_MAXTOUCH_ENABLED
    help
      Enable support for Atmel maXTouch trackpads
```

## dts/bindings/input/atmel,maxtouch.yaml
```yaml
# Copyright (c) 2024 Domologic Home Automation GmbH
# SPDX-License-Identifier: Apache-2.0

description: Atmel maxTouch capacitive touch sensor

compatible: "atmel,maxtouch"

include: ["i2c-device.yaml"]

properties:
  int-gpios:
    type: phandle-array
    description: Interrupt pin for the device
    required: true

  rst-gpios:
    type: phandle-array
    description: Reset pin for the device
    required: true
```
